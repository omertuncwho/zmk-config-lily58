## west.yml
```yaml
manifest:
  remotes:
    - name: zmkfirmware
      url-base: https://github.com/zmkfirmware
    - name: omertuncwho
      url-base: https://github.com/omertuncwho

  projects:
    - name: zmk
      remote: zmkfirmware
      revision: main
      import: app/west.yml

    - name: pim447
      remote: omertuncwho
      revision: main
      path: app/drivers/sensor/pim447

  self:
    path: config
```
